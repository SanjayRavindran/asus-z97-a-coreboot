## board/src/mainboard/asus/z97-a/Kconfig
```kconfig
## SPDX-License-Identifier: GPL-2.0-only

if BOARD_ASUS_Z97_A

config BOARD_SPECIFIC_OPTIONS
	def_bool y
	select BOARD_ROMSIZE_KB_8192
	select DEFAULT_POST_ON_LPC
	select HAVE_ACPI_RESUME
	select HAVE_ACPI_TABLES
	select INTEL_GMA_HAVE_VBT
	select MEMORY_MAPPED_TPM
	select MAINBOARD_HAS_LIBGFXINIT
	select MAINBOARD_USES_IFD_GBE_REGION
	select NORTHBRIDGE_INTEL_HASWELL
	select SERIRQ_CONTINUOUS_MODE
	select SOUTHBRIDGE_INTEL_LYNXPOINT
	select SUPERIO_NUVOTON_NCT6791D
	select USE_BROADWELL_MRC if !USE_NATIVE_RAMINIT
	select DRIVERS_OPTION_CFR_ENABLED if PAYLOAD_EDK2 && SMMSTORE

config CBFS_SIZE
	default 0x680000

config MAINBOARD_DIR
	default "asus/z97-a"

config MAINBOARD_PART_NUMBER
	default "Z97-A"

config USBDEBUG_HCD_INDEX
	default 2	# Header1: USB910 / Header2: USB3_12

endif
```

## configs/z97-a-8mb-stock-me.defconfig
```kconfig
CONFIG_LOCALVERSION="-z97a-v0.17-with-me"
CONFIG_TIMESTAMPS_ON_CONSOLE=y
CONFIG_NO_STAGE_CACHE=y
CONFIG_VENDOR_ASUS=y
CONFIG_ONBOARD_VGA_IS_PRIMARY=y
CONFIG_CONSOLE_POST=y
CONFIG_BOARD_ASUS_Z97_A=y
CONFIG_IFD_BIN_PATH="blobs/ifd-z97-a-unlocked.bin"
CONFIG_ME_BIN_PATH="blobs/me-z97-a-stock-9.1.25.1005.bin"
CONFIG_GBE_BIN_PATH="blobs/gbe-z97-a.bin"
CONFIG_PCIEXP_DEFAULT_MAX_RESIZABLE_BAR_BITS=35
CONFIG_CONSOLE_CBMEM_BUFFER_SIZE=0x40000
CONFIG_EDK2_BOOT_TIMEOUT=5
CONFIG_INTEL_OC_MAILBOX_ENABLE_UNDERVOLTING=y
CONFIG_HAVE_IFD_BIN=y
CONFIG_EDK2_BOOT_MANAGER_ESCAPE=y
# CONFIG_EDK2_FULL_SCREEN_SETUP is not set
CONFIG_EDK2_BOOTSPLASH_FILE=""
CONFIG_USE_NATIVE_RAMINIT=y
CONFIG_PCIEXP_HOTPLUG=y
CONFIG_HAVE_ME_BIN=y
CONFIG_HAVE_GBE_BIN=y
CONFIG_PCIEXP_SUPPORT_RESIZABLE_BARS=y
CONFIG_PCIEXP_LANE_ERR_STAT_CLEAR=y
CONFIG_TPM1=y
CONFIG_DEFAULT_CONSOLE_LOGLEVEL_6=y
CONFIG_CMOS_POST=y
CONFIG_CMOS_POST_OFFSET=0x70
CONFIG_PAYLOAD_EDK2=y
CONFIG_EDK2_TAG_OR_REV="f248a68be339831b69a880d9c932a6a3cf3c461a"
CONFIG_EDK2_LOAD_OPTION_ROMS=y
CONFIG_EDK2_SERIAL_SUPPORT=y
CONFIG_EDK2_CUSTOM_BUILD_PARAMS="-D BOOTSPLASH_IMAGE=FALSE -D NVME_ENABLE=TRUE"
CONFIG_EDK2_ENABLE_IPXE=y
CONFIG_IPXE_MASTER=y
# CONFIG_IPXE_SERIAL_CONSOLE is not set
```

## configs/z97-a-8mb-without-me.defconfig
```kconfig
CONFIG_LOCALVERSION="-z97a-without-me"
CONFIG_TIMESTAMPS_ON_CONSOLE=y
CONFIG_NO_STAGE_CACHE=y
CONFIG_VENDOR_ASUS=y
CONFIG_ONBOARD_VGA_IS_PRIMARY=y
CONFIG_CONSOLE_POST=y
CONFIG_BOARD_ASUS_Z97_A=y
CONFIG_IFD_BIN_PATH="blobs/ifd-z97-a-minimal-116k-unlocked.bin"
CONFIG_ME_BIN_PATH="blobs/me-z97-a-minimal-116k.bin"
CONFIG_GBE_BIN_PATH="blobs/gbe-z97-a.bin"
CONFIG_PCIEXP_DEFAULT_MAX_RESIZABLE_BAR_BITS=35
CONFIG_CONSOLE_CBMEM_BUFFER_SIZE=0x40000
CONFIG_EDK2_BOOT_TIMEOUT=5
CONFIG_INTEL_OC_MAILBOX_ENABLE_UNDERVOLTING=y
CONFIG_HAVE_IFD_BIN=y
CONFIG_EDK2_BOOT_MANAGER_ESCAPE=y
# CONFIG_EDK2_FULL_SCREEN_SETUP is not set
CONFIG_EDK2_BOOTSPLASH_FILE=""
CONFIG_USE_NATIVE_RAMINIT=y
CONFIG_PCIEXP_HOTPLUG=y
CONFIG_HAVE_ME_BIN=y
CONFIG_HAVE_GBE_BIN=y
CONFIG_ALWAYS_ALLOW_ABOVE_4G_ALLOCATION=y
CONFIG_ENABLE_VMX=y
CONFIG_POWER_STATE_ON_AFTER_FAILURE=y
CONFIG_DISABLE_ME_PCI=y
CONFIG_PCIEXP_SUPPORT_RESIZABLE_BARS=y
CONFIG_PCIEXP_LANE_ERR_STAT_CLEAR=y
CONFIG_TPM1=y
CONFIG_DEFAULT_CONSOLE_LOGLEVEL_6=y
CONFIG_CMOS_POST=y
CONFIG_CMOS_POST_OFFSET=0x70
CONFIG_PAYLOAD_EDK2=y
CONFIG_EDK2_TAG_OR_REV="f248a68be339831b69a880d9c932a6a3cf3c461a"
CONFIG_EDK2_HAVE_EFI_SHELL=y
CONFIG_EDK2_LOAD_OPTION_ROMS=y
CONFIG_EDK2_SERIAL_SUPPORT=y
CONFIG_EDK2_CUSTOM_BUILD_PARAMS="-D BOOTSPLASH_IMAGE=FALSE -D NVME_ENABLE=TRUE"
CONFIG_EDK2_ENABLE_IPXE=y
CONFIG_IPXE_MASTER=y
# CONFIG_IPXE_SERIAL_CONSOLE is not set
```
